## boards/esp32c6_devkitc_hpcore.conf
```kconfig
CONFIG_HEAP_MEM_POOL_SIZE=114688
CONFIG_USE_READY_LED_STRIP=y

CONFIG_IDLE_STACK_SIZE=512
CONFIG_NET_MGMT_EVENT_STACK_SIZE=3072
CONFIG_NET_SOCKETS_SERVICE_STACK_SIZE=3072
CONFIG_ONBOARDING_WEB_STACK_SIZE=3076

CONFIG_READY_LED_STACK_SIZE=1024
CONFIG_SHELL_STACK_SIZE=3072
CONFIG_SYSTEM_WORKQUEUE_STACK_SIZE=5128

#wifi
CONFIG_WIFI_ESP32=y
CONFIG_ESP32_WIFI_STA_AUTO_DHCPV4=y

#These are necessary for AP mode to work
CONFIG_WIFI_USAGE_MODE_STA_AP=y
CONFIG_WIFI_NM=y
CONFIG_NET_IF_MAX_IPV4_COUNT=2
CONFIG_ZVFS_POLL_MAX=6

CONFIG_NET_MGMT_EVENT_QUEUE_SIZE=16
CONFIG_NET_MGMT_EVENT_QUEUE_TIMEOUT=5000
CONFIG_NET_MGMT_EVENT_STACK_SIZE=3072

# speed improvement costs 10K ram
#CONFIG_ESP32_WIFI_IRAM_OPT=n
# speed improvement costs 17K ram
#CONFIG_ESP32_WIFI_RX_IRAM_OPT=n

#CONFIG_ESP_WIFI_HEAP_SYSTEM=y
#Debug
#CONFIG_ESP_LOG_LEVEL_DBG=y

#values from the sample program
CONFIG_NET_TX_STACK_SIZE=2048
CONFIG_NET_RX_STACK_SIZE=2048
CONFIG_BT_RX_STACK_SIZE=2048

CONFIG_SHELL_TX_TIMEOUT_MS=500


CONFIG_MAIN_STACK_SIZE=8192
CONFIG_SHELL_STACK_SIZE=8192

# As of latest main in Oct 2025, CONFIG_ASSERT causes
# some really bizarre faliures on esp32c6. Hopefully this gets fixed.
CONFIG_ASSERT=n
```

## boards/esp32s3_devkitc_esp32s3_procpu.conf
```kconfig
CONFIG_HEAP_MEM_POOL_SIZE=114688

CONFIG_IDLE_STACK_SIZE=512
CONFIG_NET_MGMT_EVENT_STACK_SIZE=3072
CONFIG_NET_SOCKETS_SERVICE_STACK_SIZE=3072
CONFIG_ONBOARDING_WEB_STACK_SIZE=3076
#no TLS
#CONFIG_ONBOARDING_WEB_STACK_SIZE=2048
CONFIG_READY_LED_STACK_SIZE=1024
CONFIG_SHELL_STACK_SIZE=3072
CONFIG_SYSTEM_WORKQUEUE_STACK_SIZE=4096

CONFIG_SERIAL=y
    
CONFIG_WIFI=y
CONFIG_NET_L2_WIFI_MGMT=y

CONFIG_WIFI_ESP32=y
CONFIG_USE_READY_LED_STRIP=y
CONFIG_ONBOARDING_SHELL=y
CONFIG_NET_SHELL=y
CONFIG_NET_L2_WIFI_SHELL=y
#WIFI Buffering
CONFIG_ESP32_WIFI_DYNAMIC_RX_MGMT_BUFFER=y
CONFIG_ESP32_WIFI_STATIC_RX_MGMT_BUFFER=n

CONFIG_ESP32_WIFI_DYNAMIC_TX_BUFFER=y
CONFIG_ESP32_WIFI_STATIC_TX_BUFFER=n

CONFIG_CONSOLE_HANDLER=y
# AP
CONFIG_ESP32_WIFI_STA_AUTO_DHCPV4=y
CONFIG_ESP32_WIFI_STA_RECONNECT=y

CONFIG_NET_CONNECTION_MANAGER=n
CONFIG_HTTP_NUM_HANDLERS=2


#CONFIG_ESP_WIFI_HEAP_SYSTEM=n
#Debug
#CONFIG_ESP_LOG_LEVEL_DBG=y

#CONFIG_GOLIOTH_PSK_ID="20241113162258-esp32_1@webblinky"
#CONFIG_GOLIOTH_PSK="31fded193fb58cce277baaee5c4f613b"
```

## boards/qemu_x86_64.conf
```kconfig
#CONFIG_NET_QEMU_USER=y
#CONFIG_QEMU_NETWORKING=y
CONFIG_NET_DRIVERS=y
CONFIG_PCIE=y
CONFIG_NET_L2_ETHERNET=y
CONFIG_NET_QEMU_ETHERNET=y
CONFIG_ETH_E1000=y
```

## boards/rpi_pico2_rp2350a_m33_w.conf
```kconfig
CONFIG_HEAP_MEM_POOL_SIZE=98304

CONFIG_COMMON_LIBC_MALLOC_ARENA_SIZE=2048
CONFIG_SYSTEM_WORKQUEUE_STACK_SIZE=4096
CONFIG_NET_MGMT_EVENT_STACK_SIZE=3072
CONFIG_MAIN_STACK_SIZE=5200
CONFIG_SHELL_STACK_SIZE=5200
CONFIG_NET_TX_STACK_SIZE=2048
CONFIG_NET_RX_STACK_SIZE=2048
CONFIG_IDLE_STACK_SIZE=1024

CONFIG_NET_PKT_RX_COUNT=10
CONFIG_NET_PKT_TX_COUNT=10
CONFIG_NET_BUF_RX_COUNT=20
CONFIG_NET_BUF_TX_COUNT=20

CONFIG_USE_READY_LED=y
CONFIG_USE_READY_LED_PICO_W=y
CONFIG_READY_LED_STACK_SIZE=1024
 
CONFIG_CONSOLE=y
CONFIG_SERIAL=y
CONFIG_UART_CONSOLE=y

CONFIG_GPIO_SHELL=y

CONFIG_ENTROPY_GENERATOR=y
CONFIG_TEST_RANDOM_GENERATOR=y

CONFIG_WIFI=y
CONFIG_ONBOARDING_WIFI_AP_DISABLE=y
    
CONFIG_USE_BUTTON=n

CONFIG_NET_STATISTICS=y
CONFIG_NET_STATISTICS_WIFI=y
CONFIG_NET_STATISTICS_USER_API=y


CONFIG_NET_DEBUG_NET_PKT_ALLOC=y
CONFIG_EXTRA_EXCEPTION_INFO=y
CONFIG_NET_BUF_LOG=y
```

## manifest/west.yml
```yaml
manifest:
  version: 1.2

  remotes:
    - name: beechwoods
      url-base: https://github.com/beechwoods-software
      
    - name: zephyr-project
      url-base: https://github.com/zephyrproject-rtos
    
  projects:
    - name: zephyr
      remote: zephyr-project
      repo-path: zephyr
      revision: 71f6840a1b1b802437848157968b45cf621d104a
      path: zephyr
      import:
        path-prefix: external
        name-allowlist:
          - cmsis_6
          - hal_infineon
          - hal_rpi_pico
          - zephyr
       
    - name: onboarding
      remote: beechwoods
      repo-path: onboarding
      revision: e48048b217d1adccc6bd425ed1537f344b0ff16f
      path: onboarding
      
    - name: st25dv
      remote: beechwoods
      repo-path: st25dv
      revision: 952205676cfd9af258dc56e046f17b607b3071a5
      path: onboarding/st25dv
    
    - name: sensors
      remote: beechwoods
      repo-path: sensors
      revision: 0a75132bfeaa5383c6fde677c0fe31b74b81f278
      path: sensors
      
  self:
    path: .
```

## snippets/golioth/boards/esp32_devkitc_wroom_procpu.conf
```kconfig
CONFIG_GOLIOTH_PSK_ID="20241113162258-esp32_1@webblinky"
CONFIG_GOLIOTH_PSK="31fded193fb58cce277baaee5c4f613b"
#CONFIG_HEAP_MEM_POOL_SIZE=67584
#CONFIG_HEAP_MEM_POOL_SIZE=49152
#CONFIG_HEAP_MEM_POOL_SIZE=5017
CONFIG_ESP_HEAP_MEM_POOL_REGION_1_SIZE=49152
```

## snippets/golioth/boards/esp32_devkitc_wrover_procpu.conf
```kconfig
CONFIG_GOLIOTH_PSK_ID="20241118194259-esp32_wrover_cam@webblinky"
CONFIG_GOLIOTH_PSK="28ad89ca374025ae0d807fcf875daaf3"
```

## snippets/golioth/boards/rpi_pico_rp2040_w.conf
```kconfig
CONFIG_GOLIOTH_PSK_ID="20250219195731-rpi_pico_rp2040_w@webblinky"
CONFIG_GOLIOTH_PSK="9ca1e4221fe065d2a25eb037730c167b"
CONFIG_COMMON_LIBC_MALLOC_ARENA_SIZE=16384
CONFIG_HEAP_MEM_POOL_SIZE=49152

    
```

## snippets/updatehub/boards/esp32_devkitc_wroom_procpu.conf
```kconfig
#CONFIG_HEAP_MEM_POOL_SIZE=20479
CONFIG_UPDATEHUB_PRODUCT_UID="a51b986b298b2a21e3754b4124c235d7ce7c8f5a1415cd200df6ac0624433310"
```
